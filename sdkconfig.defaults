## sdkconfig.defaults
```kconfig
# ESP32-P4 Function EV Board Configuration
CONFIG_ESP32P4_FUNCTION_EV_BOARD=y
CONFIG_ESPTOOLPY_FLASHFREQ_120M=y
CONFIG_ESPTOOLPY_FLASH_MODE_QIO=y
CONFIG_ESPTOOLPY_FLASH_SIZE_8MB=y
CONFIG_ESPTOOLPY_PSRAM_SIZE_8MB=y
CONFIG_ESPTOOLPY_PSRAM_MODE_OCT=y

# LVGL Configuration
CONFIG_LVGL_9_2=y
CONFIG_LVGL_9_X=y
CONFIG_LVGL_MEM_CUSTOM=y
CONFIG_LVGL_MEM_SET_SIZE=131072
CONFIG_LVGL_FONT_MONTSERRAT_16=y
CONFIG_LVGL_FONT_MONTSERRAT_24=y
CONFIG_LVGL_FONT_MONTSERRAT_32=y
CONFIG_LVGL_USE_THEME_DEFAULT=y
CONFIG_LVGL_USE_THEME_ALCOLA=y

# Display Configuration (7" 1024x600 RGB)
CONFIG_LCD_RGB_DATA_WIDTH=24
CONFIG_LCD_RGB_GPIO_R=18
CONFIG_LCD_RGB_GPIO_G=19
CONFIG_LCD_RGB_GPIO_B=20
CONFIG_LCD_RGB_GPIO_HSYNC=21
CONFIG_LCD_RGB_GPIO_VSYNC=22
CONFIG_LCD_RGB_GPIO_DE=23
CONFIG_LCD_RGB_GPIO_PCLK=24
CONFIG_LCD_RGB_PCLK_ACTIVE_1=y
CONFIG_LCD_RGB_HPULSE_1=y
CONFIG_LCD_RGB_VPULSE_1=y
CONFIG_LCD_RGB_DE_ACTIVE_HIGH=y
CONFIG_LCD_RGB_FREQ_HZ=51200000
CONFIG_LCD_RGB_H_RES=1024
CONFIG_LCD_RGB_V_RES=600

# USB CDC Configuration
CONFIG_TINYUSB_CDC_ENABLED=y
CONFIG_TINYUSB_CDC_COUNT=1
CONFIG_TINYUSB_ENABLED=y

# FreeRTOS Configuration
CONFIG_FREERTOS_HZ=1000
CONFIG_FREERTOS_UNICODE=y
CONFIG_FREERTOS_TASK_FUNCTION_WRAPPER=y

# SPIFFS Configuration
CONFIG_SPIFFS_MAX_PARTITIONS=3

# NVS Configuration
CONFIG_NVS_ENCRYPTION=y

# ESP32-P4 Specific
CONFIG_ESP32P4_REV_MIN=0
CONFIG_ESP32P4_CPU_FREQ_240M=y
CONFIG_ESP32P4_HAS_PSRAM=y
CONFIG_ESP32P4_PSRAM_SIZE_8MB=y
```
